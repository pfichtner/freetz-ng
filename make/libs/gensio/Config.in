## make/libs/gensio/Config.in
```kconfig
config FREETZ_LIB_libgensio
	bool "libgensio (libgensio.so)"
	depends on !(FREETZ_TARGET_UCLIBC_0_9_28 || FREETZ_TARGET_UCLIBC_0_9_29)
	select FREETZ_LIB_libgensioosh
	select FREETZ_LIB_libgensiomdns
	select FREETZ_LIB_libpthread if FREETZ_TARGET_UCLIBC_HAS_multiple_libs
	default n
	help
		Gensio - a library for abstracting stream I/O. Provides network
		and serial I/O with support for TCP, UDP, serial devices, and
		telnet. SSL/TLS is not included (built with --with-ssl=no).

config FREETZ_LIB_libgensioosh
	bool "libgensioosh (libgensioosh.so)"
	depends on !(FREETZ_TARGET_UCLIBC_0_9_28 || FREETZ_TARGET_UCLIBC_0_9_29)
	select FREETZ_LIB_libpthread if FREETZ_TARGET_UCLIBC_HAS_multiple_libs
	default n
	help
		Gensio OS helper library - provides OS abstraction functions.

config FREETZ_LIB_libgensiomdns
	bool "libgensiomdns (libgensiomdns.so)"
	depends on !(FREETZ_TARGET_UCLIBC_0_9_28 || FREETZ_TARGET_UCLIBC_0_9_29)
	select FREETZ_LIB_libgensioosh
	default n
	help
		Gensio mDNS library stub. Built without avahi support (--with-mdns=no),
		so all mDNS functions return GE_NOTSUP. Required by consumers (e.g.
		ser2net) that link against libgensiomdns regardless of mDNS usage.
```

## make/pkgs/hello-pkg/Config.in
```kconfig
config FREETZ_PACKAGE_HELLO_PKG
	bool "hello-pkg (runtime package test fixture)"
	default n
	depends on FREETZ_PACKAGE_PKGMANAGER
	help
		Minimal test package for the Freetz-NG runtime package manager.
		Installs a 'hello' script under the package root.
		Use 'pkg install' to install the resulting .fpkg archive.
```

## make/pkgs/pkgmanager/Config.in
```kconfig
config FREETZ_PACKAGE_PKGMANAGER
	bool "Runtime Package Manager 1.0 (scripts only)"
	default n
	depends on FREETZ_TARGET_ARCH_ARM
	help
		Runtime package manager for Freetz-NG.
		Installs optional packages onto USB storage without reflashing.

		The 'pkg' command supports:
		  pkg status   - show storage and database health
		  pkg list     - list installed packages
		  pkg info     - show package metadata
		  pkg install  - install a .fpkg archive
		  pkg remove   - remove an installed package

		Requires USB storage mounted at the configured path.
		First supported target: ARM 32-bit (arm-linux-uclibcgnueabi).
```

## make/pkgs/ser2net/Config.in
```kconfig
config FREETZ_PACKAGE_SER2NET
	bool "ser2net 3.5.4/4.6.8"
	default n
	help
		Ser2net is a program for allowing network connections to serial
		ports. It supports RFC 2217 (remote control of serial port
		parameters), but you must have a compliant client.
		Configuration format differs by version (see help).

if FREETZ_PACKAGE_SER2NET

	choice
		prompt "Version"
			default FREETZ_PACKAGE_SER2NET_CURRENT

		config FREETZ_PACKAGE_SER2NET_ABANDON
			bool "3.5.4 (legacy)"
			help
				Legacy ser2net 3.5.4 using traditional config format
				(ser2net.conf). Compatible with older build environments.

		config FREETZ_PACKAGE_SER2NET_CURRENT
			bool "4.6.8"
			select FREETZ_LIB_libgensio
			select FREETZ_LIB_libgensioosh
			select FREETZ_LIB_libgensiomdns
			select FREETZ_LIB_libyaml
			select FREETZ_LIB_libpthread if FREETZ_TARGET_UCLIBC_HAS_multiple_libs
			help
				ser2net 4.6.8 using YAML configuration format (ser2net.yaml).
				Requires gensio and yaml libraries.

	endchoice

endif
```
